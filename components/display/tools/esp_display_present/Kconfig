## components/display/tools/esp_display_present/Kconfig
```kconfig
menu "Display presenter"
config ESP_DISPLAY_PRESENT_BACKEND_TASK_PRIORITY
    int "Backend task priority (0 inherits producer at binding)"
    range 0 24
    default 0
    help
        Applies to backend tasks created by the public presenter for RGB, DSI,
        TE and background Panel IO. Zero snapshots the creating task priority,
        then snapshots the producer priority on each successful producer bind.
        Nonzero selects one fixed FreeRTOS task priority across all sessions.
        No priority changes occur on submit, commit, completion or scene changes.
        Choose an explicit value when the application needs a particular ordering
        relative to rendering and other tasks. This does not configure dedicated
        pixel workers, which retain their first-submit priority policy.

config ESP_DISPLAY_PRESENT_DEFAULT_TILE_BYTES
    int "Default input tile byte target"
    range 64 1048576
    default 32768
    help
        Used only when drawbuf.lines is zero. Rounded down to logical whole
        rows and capped by height. At least one row is allocated, so a single
        row may exceed this target. Explicit drawbuf.lines takes precedence.

config ESP_DISPLAY_PRESENT_IO_STAGING_SLOT_BYTES
    int "Panel IO internal DMA staging byte limit per slot"
    range 64 65536
    default 16384
    help
        REGION conversion and TE PSRAM images without direct DMA use two slots. Each logical
        capacity is rounded down to physical whole rows and capped by height.
        A row larger than this limit is rejected. Allocations are aligned up
        to 64 bytes; account for both slots, their event and adapter metadata.
        REGION allocates the slots lazily on its first non-direct request.
        TE internal DMA compose images and direct PSRAM DMA allocate no slots.

config ESP_DISPLAY_PRESENT_CALLBACK_JOIN
    bool
    default y
    select ESP_IPC_ENABLE if !ESP_SYSTEM_SINGLE_CORE_MODE
    help
        Borrowed display callbacks require a cross-core join before freeing
        their context. Enable the IDF IPC dependency as part of this component.

config ESP_DISPLAY_PRESENT_RGB_BOUNCE_CONFIRMED
    bool "Application confirms borrowed RGB panel uses bounce buffers"
    default n
    help
        For older RGB drivers without a framebuffer capability query, enable
        only if the borrowed panel was created with RGB bounce buffers. When
        the query is available, the driver-reported configuration is used.
endmenu
```
