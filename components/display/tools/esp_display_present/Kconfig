## components/display/tools/esp_display_present/Kconfig
```kconfig
menu "Display presenter"
config ESP_DISPLAY_PRESENT_GRAM_BACKGROUND
    bool "Experimental zero-copy GRAM background submission"
    default n
    help
        Use the existing engine backend worker for synchronous internal DMA tile paths.
        Rotated and PSRAM tiles retain their existing async-copy scheduling.
        Adds the backend worker task when the synchronous GRAM path would not have one.
        Source tiles remain borrowed until real transfer completion.

config ESP_DISPLAY_PRESENT_GRAM_BACKGROUND_PRIORITY
    int "GRAM backend worker task priority"
    depends on ESP_DISPLAY_PRESENT_GRAM_BACKGROUND
    range 1 24
    default 7
    help
        Priority of the existing engine backend worker for experimental GRAM submission.
        Choose relative to the producer: a lower-priority backend worker can introduce
        command refill gaps while rendering continues. The board comparison
        uses producer priority 6 and backend worker priority 7.

config ESP_DISPLAY_PRESENT_FB_IRAM
    bool "Place framebuffer task hot paths in IRAM"
    depends on IDF_TARGET_ESP32S3
    default y
    help
        Keep framebuffer engine and pixel-copy task code in internal RAM.
        On ESP32-S3 RGB bounce displays, this reduces external Flash access
        during PSRAM framebuffer preparation. With a 16 KiB instruction cache,
        the default Flash placement can miss the next scanout boundary even
        after single-boundary retirement is enabled.

        This costs approximately 19 KiB of additional IRAM in the measured
        build; the exact size depends on compiler and application reachability.
        Disable to prioritize internal memory over framebuffer throughput.
        This option does not make task APIs safe to call from an ISR or while
        the external-memory cache is disabled.

config PV2_LEGACY_CALLBACK_JOIN
    bool
    default y
    select ESP_IPC_ENABLE if !ESP_SYSTEM_SINGLE_CORE_MODE
    help
        Borrowed display callbacks require a cross-core join before freeing
        their context. Enable the IDF IPC dependency as part of this component.

config PV2_LEGACY_RGB_BOUNCE_CONFIRMED
    bool "Application confirms borrowed RGB panel uses bounce buffers"
    default n
    help
        For older RGB drivers without a framebuffer capability query, enable
        only if the borrowed panel was created with RGB bounce buffers. When
        the query is available, the driver-reported configuration is used.
endmenu
```

## components/display/tools/esp_display_present/dev/evidence/s31-te-lifecycle-20261106/sdkconfig.defaults
```kconfig
CONFIG_ESPTOOLPY_FLASHSIZE_16MB=y
CONFIG_SPIRAM=y
CONFIG_SPIRAM_USE_MALLOC=y
CONFIG_FREERTOS_HZ=1000
CONFIG_ESP_MAIN_TASK_STACK_SIZE=8192
CONFIG_COMPILER_OPTIMIZATION_PERF=y

CONFIG_SPIRAM_MODE_OCT=y
CONFIG_SPIRAM_SPEED_200M=y
CONFIG_ESP_CONSOLE_USB_SERIAL_JTAG=y

CONFIG_ESP_MAIN_TASK_STACK_SIZE=16384
```

## components/display/tools/esp_display_present/dev/test_apps/legacy_compat/board_probe/sdkconfig.defaults
```kconfig
CONFIG_LV_USE_DEMO_BENCHMARK=y
CONFIG_LV_BUILD_DEMOS=y
CONFIG_LV_COLOR_DEPTH_16=y
CONFIG_LV_USE_LOG=y
CONFIG_LV_LOG_LEVEL_INFO=y
CONFIG_ESP_MAIN_TASK_STACK_SIZE=8192

CONFIG_LV_USE_BUILTIN_MALLOC=n
CONFIG_LV_USE_CLIB_MALLOC=y
CONFIG_LV_USE_BUILTIN_STRING=n
CONFIG_LV_USE_CLIB_STRING=y
CONFIG_LV_USE_BUILTIN_SPRINTF=n
CONFIG_LV_USE_CLIB_SPRINTF=y
CONFIG_LV_BUILD_EXAMPLES=n

CONFIG_PARTITION_TABLE_SINGLE_APP=n
CONFIG_PARTITION_TABLE_CUSTOM=y
CONFIG_PARTITION_TABLE_CUSTOM_FILENAME="partitions.csv"

CONFIG_LV_USE_SYSMON=y
CONFIG_LV_USE_PERF_MONITOR=y
```

## components/display/tools/esp_display_present_v2/compat/esp_display_present/Kconfig
```kconfig
menu "V2 legacy facade"
config PV2_LEGACY_CALLBACK_JOIN
    bool
    default y
    select ESP_IPC_ENABLE if !ESP_SYSTEM_SINGLE_CORE_MODE
    help
        Borrowed display callbacks require a cross-core join before freeing
        their context. Enable the IDF IPC dependency as part of this component.

config PV2_LEGACY_RGB_BOUNCE_CONFIRMED
    bool "Application confirms borrowed RGB panel uses bounce buffers"
    default n
    help
        Enable only when the panel was created with RGB bounce buffers.
        An opaque RGB handle cannot prove this fact; otherwise RGB is rejected.
endmenu
```
